## br2_external/Config.in
```kconfig
menu "Interpreter languages and scripting"
  source "$BR2_EXTERNAL_AETHOS_PATH/package/golang/Config.in"
endmenu

menu "AethOS / IndieZen"
#  source "$BR2_EXTERNAL_AETHOS_PATH/package/etcd/Config.in"
  source "$BR2_EXTERNAL_AETHOS_PATH/package/zenspaces/Config.in"
  source "$BR2_EXTERNAL_AETHOS_PATH/package/zenfuse/Config.in"
endmenu
```

## br2_external/configs/aethos_rpi_full_defconfig
```kconfig
BR2_arm=y
BR2_arm1176jzf_s=y
BR2_PACKAGE_HOST_LINUX_HEADERS_CUSTOM_4_4=y
BR2_TOOLCHAIN_BUILDROOT_GLIBC=y
BR2_TOOLCHAIN_BUILDROOT_CXX=y
BR2_TARGET_GENERIC_ISSUE="Welcome to AethOS on Raspberry Pi"
BR2_INIT_SYSTEMD=y
BR2_SYSTEM_BIN_SH_BASH=y
BR2_SYSTEM_DHCP="eth0"
BR2_ROOTFS_POST_BUILD_SCRIPT="${BR2_EXTERNAL}/board/aethos/rpi/post-build.sh"
BR2_ROOTFS_POST_IMAGE_SCRIPT="${BR2_EXTERNAL}/board/aethos/rpi/post-image.sh"
BR2_LINUX_KERNEL=y
BR2_LINUX_KERNEL_CUSTOM_GIT=y
BR2_LINUX_KERNEL_CUSTOM_REPO_URL="https://github.com/raspberrypi/linux.git"
BR2_LINUX_KERNEL_CUSTOM_REPO_VERSION="26f3b72a9c049be10e6af196252283e1f6ab9d1f"
BR2_LINUX_KERNEL_USE_CUSTOM_CONFIG=y
BR2_LINUX_KERNEL_CUSTOM_CONFIG_FILE="${BR2_EXTERNAL}/board/aethos/rpi/linux-4.4-full.config"
BR2_LINUX_KERNEL_DTS_SUPPORT=y
BR2_LINUX_KERNEL_INTREE_DTS_NAME="bcm2708-rpi-b bcm2708-rpi-b-plus bcm2708-rpi-cm"
BR2_PACKAGE_BZIP2=y
BR2_PACKAGE_BINUTILS=y
BR2_PACKAGE_BINUTILS_TARGET=y
BR2_PACKAGE_GIT=y
BR2_PACKAGE_SUBVERSION=y
BR2_PACKAGE_BTRFS_PROGS=y
BR2_PACKAGE_RPI_FIRMWARE=y
# BR2_PACKAGE_RPI_FIRMWARE_INSTALL_DTB_OVERLAYS is not set
BR2_PACKAGE_BIND=y
BR2_PACKAGE_BIND_TOOLS=y
BR2_PACKAGE_OPENSSH=y
BR2_PACKAGE_WIRELESS_TOOLS=y
BR2_PACKAGE_WIRELESS_TOOLS_LIB=y
BR2_PACKAGE_DIALOG=y
BR2_PACKAGE_SUDO=y
BR2_PACKAGE_LXC=y
BR2_PACKAGE_NANO=y
BR2_TARGET_ROOTFS_EXT2=y
BR2_TARGET_ROOTFS_EXT2_4=y
# BR2_TARGET_ROOTFS_TAR is not set
BR2_PACKAGE_HOST_DOSFSTOOLS=y
BR2_PACKAGE_HOST_GENIMAGE=y
BR2_PACKAGE_HOST_MTOOLS=y
BR2_PACKAGE_GOLANG=y
BR2_PACKAGE_ETCD=n
```

## br2_external/configs/aethos_x86_64_defconfig
```kconfig
BR2_x86_64=y
BR2_SHARED_STATIC_LIBS=y
BR2_KERNEL_HEADERS_4_5=y
BR2_GCC_VERSION_6_X=y
BR2_TOOLCHAIN_BUILDROOT_CXX=y
BR2_LINUX_KERNEL=y
BR2_LINUX_KERNEL_USE_CUSTOM_CONFIG=y
#BR2_LINUX_KERNEL_CUSTOM_CONFIG_FILE="/root/linux-4.5.3/.config"
BR2_LINUX_KERNEL_CUSTOM_CONFIG_FILE="board/aethos/x86_64/linux-4.5.config"
BR2_PACKAGE_BZIP2=y
BR2_PACKAGE_GIT=y
BR2_PACKAGE_LIBTOOL=y
BR2_PACKAGE_MAKE=y
BR2_PACKAGE_PKGCONF=y
BR2_PACKAGE_JOE=y
BR2_TARGET_ROOTFS_EXT2=y
BR2_TARGET_ROOTFS_INITRAMFS=y
BR2_TARGET_ROOTFS_ISO9660=y
BR2_TARGET_ROOTFS_TAR_GZIP=y
BR2_TARGET_GRUB=y
# BR2_TARGET_GRUB_FS_FAT is not set
```

## br2_external/configs/aethos_x86_64_full_defconfig
```kconfig
BR2_x86_64=y
BR2_OPTIMIZE_2=y
BR2_SHARED_STATIC_LIBS=y
BR2_PACKAGE_HOST_LINUX_HEADERS_CUSTOM_4_4=y
BR2_TOOLCHAIN_BUILDROOT_GLIBC=y
BR2_GLIBC_VERSION_2_23=y
BR2_GCC_VERSION_5_X=y
BR2_TOOLCHAIN_BUILDROOT_CXX=y
BR2_TARGET_GENERIC_HOSTNAME="aethos"
BR2_TARGET_GENERIC_ISSUE="Welcome to AethOS"
BR2_INIT_SYSV=y
BR2_ROOTFS_DEVICE_CREATION_DYNAMIC_MDEV=y
BR2_ROOTFS_MERGED_USR=y
BR2_SYSTEM_BIN_SH_DASH=y
BR2_SYSTEM_DHCP="eth0"
BR2_ROOTFS_OVERLAY="/root/rootfs/x86_64/full"
BR2_ROOTFS_POST_BUILD_SCRIPT="${BR2_EXTERNAL}/board/aethos/x86_64/post_build_full.sh"
BR2_LINUX_KERNEL=y
BR2_LINUX_KERNEL_CUSTOM_VERSION=y
BR2_LINUX_KERNEL_CUSTOM_VERSION_VALUE="4.4"
BR2_LINUX_KERNEL_USE_CUSTOM_CONFIG=y
BR2_LINUX_KERNEL_CUSTOM_CONFIG_FILE="${BR2_EXTERNAL}/board/aethos/x86_64/linux-4.5-full.config"
BR2_PACKAGE_GZIP=y
BR2_PACKAGE_GIT=y
BR2_PACKAGE_LIBTOOL=y
BR2_PACKAGE_MAKE=y
BR2_PACKAGE_PATCH=y
BR2_PACKAGE_PKGCONF=y
BR2_PACKAGE_SED=y
BR2_PACKAGE_SUBVERSION=y
BR2_PACKAGE_BTRFS_PROGS=y
BR2_PACKAGE_E2TOOLS=y
BR2_PACKAGE_F2FS_TOOLS=y
BR2_PACKAGE_GENEXT2FS=y
BR2_PACKAGE_DBUS=y
BR2_PACKAGE_DBUS_CPP=y
BR2_PACKAGE_NODEJS=y
BR2_PACKAGE_NODEJS_NPM=y
BR2_PACKAGE_NODEJS_MODULES_EXPRESS=y
BR2_PACKAGE_PYTHON=y
BR2_PACKAGE_PYTHON_BZIP2=y
BR2_PACKAGE_PYTHON_BSDDB=y
BR2_PACKAGE_PYTHON_CODECSCJK=y
BR2_PACKAGE_PYTHON_CURSES=y
BR2_PACKAGE_PYTHON_OSSAUDIODEV=y
BR2_PACKAGE_PYTHON_READLINE=y
BR2_PACKAGE_PYTHON_SSL=y
BR2_PACKAGE_PYTHON_SQLITE=y
BR2_PACKAGE_PYTHON_PYEXPAT=y
BR2_PACKAGE_PYTHON_ZLIB=y
BR2_PACKAGE_PYTHON_HASHLIB=y
BR2_PACKAGE_LIBFUSE=y
BR2_PACKAGE_ZYRE=y
BR2_PACKAGE_BOOST_ATOMIC=y
BR2_PACKAGE_BOOST_CHRONO=y
BR2_PACKAGE_BOOST_CONTAINER=y
BR2_PACKAGE_BOOST_CONTEXT=y
BR2_PACKAGE_BOOST_COROUTINE=y
BR2_PACKAGE_BOOST_COROUTINE2=y
BR2_PACKAGE_BOOST_DATE_TIME=y
BR2_PACKAGE_BOOST_EXCEPTION=y
BR2_PACKAGE_BOOST_FILESYSTEM=y
BR2_PACKAGE_BOOST_GRAPH=y
BR2_PACKAGE_BOOST_GRAPH_PARALLEL=y
BR2_PACKAGE_BOOST_IOSTREAMS=y
BR2_PACKAGE_BOOST_LOCALE=y
BR2_PACKAGE_BOOST_LOG=y
BR2_PACKAGE_BOOST_MATH=y
BR2_PACKAGE_BOOST_MPI=y
BR2_PACKAGE_BOOST_PYTHON=y
BR2_PACKAGE_BOOST_RANDOM=y
BR2_PACKAGE_BOOST_REGEX=y
BR2_PACKAGE_BOOST_SERIALIZATION=y
BR2_PACKAGE_BOOST_SIGNALS=y
BR2_PACKAGE_BOOST_SYSTEM=y
BR2_PACKAGE_BOOST_TEST=y
BR2_PACKAGE_BOOST_THREAD=y
BR2_PACKAGE_BOOST_TIMER=y
BR2_PACKAGE_BOOST_WAVE=y
BR2_PACKAGE_LIBGLIB2=y
BR2_PACKAGE_MPDECIMAL=y
BR2_PACKAGE_NCURSES_WCHAR=y
BR2_PACKAGE_GOOGLEFONTDIRECTORY=y
BR2_PACKAGE_IFPLUGD=y
BR2_PACKAGE_IFUPDOWN=y
BR2_PACKAGE_IPROUTE2=y
BR2_PACKAGE_MONGREL2=y
BR2_PACKAGE_NGINX=y
BR2_PACKAGE_NGINX_THREADS=y
BR2_PACKAGE_NGINX_HTTP_CACHE=y
BR2_PACKAGE_NGINX_HTTP_SSL_MODULE=y
BR2_PACKAGE_NGINX_HTTP_V2_MODULE=y
BR2_PACKAGE_NTP=y
BR2_PACKAGE_NTP_SNTP=y
BR2_PACKAGE_NTP_NTP_KEYGEN=y
BR2_PACKAGE_NTP_NTPD_ATOM_PPS=y
BR2_PACKAGE_NTP_NTPDATE=y
BR2_PACKAGE_NTP_NTPDC=y
BR2_PACKAGE_OPENSSH=y
BR2_PACKAGE_RSYNC=y
BR2_PACKAGE_WGET=y
BR2_PACKAGE_OPKG=y
BR2_PACKAGE_OPKG_GPG_SIGN=y
BR2_PACKAGE_BASH=y
BR2_PACKAGE_DIALOG=y
BR2_PACKAGE_SUDO=y
BR2_PACKAGE_TIME=y
BR2_PACKAGE_WHICH=y
BR2_PACKAGE_BOOTUTILS=y
BR2_PACKAGE_COREUTILS=y
BR2_PACKAGE_DEBIANUTILS=y
BR2_PACKAGE_KMOD=y
BR2_PACKAGE_KMOD_TOOLS=y
BR2_PACKAGE_LXC=y
BR2_PACKAGE_START_STOP_DAEMON=y
BR2_PACKAGE_TAR=y
BR2_PACKAGE_UTIL_LINUX_BINARIES=y
BR2_PACKAGE_UTIL_LINUX_HWCLOCK=y
BR2_PACKAGE_UTIL_LINUX_MOUNT=y
BR2_PACKAGE_UTIL_LINUX_NOLOGIN=y
BR2_PACKAGE_LESS=y
BR2_PACKAGE_NANO=y
BR2_TARGET_ROOTFS_CPIO_UIMAGE=y
BR2_TARGET_ROOTFS_EXT2=y
BR2_TARGET_ROOTFS_EXT2_4=y
BR2_TARGET_ROOTFS_INITRAMFS=y
BR2_TARGET_ROOTFS_ISO9660=y
BR2_TARGET_ROOTFS_TAR_GZIP=y
BR2_TARGET_GRUB=y
# BR2_TARGET_GRUB_FS_FAT is not set
BR2_PACKAGE_HOST_E2TOOLS=y
BR2_PACKAGE_HOST_UTIL_LINUX=y
BR2_PACKAGE_GOLANG=y
BR2_PACKAGE_ZENSPACES=y
```

## br2_external/configs/aethos_x86_64_min_defconfig
```kconfig
BR2_x86_64=y
BR2_SHARED_STATIC_LIBS=y
BR2_PACKAGE_HOST_LINUX_HEADERS_CUSTOM_4_4=y
BR2_TOOLCHAIN_BUILDROOT_GLIBC=y
BR2_GLIBC_VERSION_2_23=y
BR2_GCC_VERSION_5_X=y
BR2_TOOLCHAIN_BUILDROOT_CXX=y
BR2_TARGET_GENERIC_HOSTNAME="aethos"
BR2_TARGET_GENERIC_ISSUE="Welcome to AethOS Installation CD"
BR2_ROOTFS_DEVICE_CREATION_DYNAMIC_MDEV=y
BR2_ROOTFS_MERGED_USR=y
BR2_SYSTEM_BIN_SH_BASH=y
BR2_SYSTEM_DHCP="eth0"
BR2_ROOTFS_OVERLAY="/root/rootfs/x86_64/min"
BR2_LINUX_KERNEL=y
BR2_LINUX_KERNEL_CUSTOM_VERSION=y
BR2_LINUX_KERNEL_CUSTOM_VERSION_VALUE="4.4"
BR2_LINUX_KERNEL_USE_CUSTOM_CONFIG=y
BR2_LINUX_KERNEL_CUSTOM_CONFIG_FILE="${BR2_EXTERNAL}/board/aethos/x86_64/linux-4.5-min.config"
BR2_PACKAGE_BUSYBOX_CONFIG="${BR2_EXTERNAL}/board/aethos/x86_64/busybox-min.config"
BR2_PACKAGE_BUSYBOX_SHOW_OTHERS=y
BR2_PACKAGE_GZIP=y
BR2_PACKAGE_BINUTILS=y
BR2_PACKAGE_BINUTILS_TARGET=y
BR2_PACKAGE_GAWK=y
BR2_PACKAGE_GIT=y
BR2_PACKAGE_LIBTOOL=y
BR2_PACKAGE_MAKE=y
BR2_PACKAGE_PATCH=y
BR2_PACKAGE_PKGCONF=y
BR2_PACKAGE_SUBVERSION=y
BR2_PACKAGE_E2FSPROGS_E2IMAGE=y
BR2_PACKAGE_E2FSPROGS_RESIZE2FS=y
BR2_PACKAGE_E2TOOLS=y
BR2_PACKAGE_XFSPROGS=y
BR2_PACKAGE_PYTHON=y
BR2_PACKAGE_PYTHON_BZIP2=y
BR2_PACKAGE_PYTHON_BSDDB=y
BR2_PACKAGE_PYTHON_CODECSCJK=y
BR2_PACKAGE_PYTHON_CURSES=y
BR2_PACKAGE_PYTHON_OSSAUDIODEV=y
BR2_PACKAGE_PYTHON_READLINE=y
BR2_PACKAGE_PYTHON_SSL=y
BR2_PACKAGE_PYTHON_SQLITE=y
BR2_PACKAGE_PYTHON_PYEXPAT=y
BR2_PACKAGE_PYTHON_ZLIB=y
BR2_PACKAGE_PYTHON_HASHLIB=y
BR2_PACKAGE_OPENSSH=y
BR2_PACKAGE_RSYNC=y
BR2_PACKAGE_OPKG=y
BR2_PACKAGE_OPKG_GPG_SIGN=y
BR2_PACKAGE_DIALOG=y
BR2_PACKAGE_SUDO=y
BR2_PACKAGE_TIME=y
BR2_PACKAGE_BOOTUTILS=y
BR2_PACKAGE_COREUTILS=y
BR2_PACKAGE_TAR=y
BR2_PACKAGE_UTIL_LINUX_BINARIES=y
BR2_PACKAGE_UTIL_LINUX_FINDFS=y
BR2_PACKAGE_UTIL_LINUX_MORE=y
BR2_PACKAGE_UTIL_LINUX_MOUNT=y
BR2_PACKAGE_UTIL_LINUX_PARTX=y
BR2_PACKAGE_NANO=y
BR2_TARGET_ROOTFS_EXT2=y
BR2_TARGET_ROOTFS_INITRAMFS=y
BR2_TARGET_ROOTFS_ISO9660=y
BR2_TARGET_ROOTFS_TAR_GZIP=y
BR2_TARGET_GRUB=y
# BR2_TARGET_GRUB_FS_FAT is not set
BR2_TARGET_SYSLINUX=y
```

## br2_external/package/golang/Config.in
```kconfig
comment "golang needs a toolchain w/ threads, dynamic library"
	depends on BR2_PACKAGE_GOLANG_ARCH_SUPPORTS
	depends on !BR2_TOOLCHAIN_HAS_THREADS || BR2_STATIC_LIBS

# golang only supports x86, x86_64 and ARM (LE) targets.
# For ARM, armv5 or above is required.
config BR2_PACKAGE_GOLANG_ARCH_SUPPORTS
	bool
	default y
	depends on BR2_USE_MMU
	depends on BR2_i386 || BR2_x86_64 || BR2_arm
	depends on !BR2_ARM_CPU_ARMV4

config BR2_PACKAGE_GOLANG
	bool "golang"
	depends on BR2_PACKAGE_GOLANG_ARCH_SUPPORTS
	depends on !BR2_STATIC_LIBS
	depends on BR2_TOOLCHAIN_HAS_THREADS
	help
	  Go interpreter and cli tool. Not required for running pre-compiled Go binaries.

	  http://golang.org/
    
```

## br2_external/package/zenfuse/Config.in
```kconfig
config BR2_PACKAGE_ZENFUSE_LIBC_SUPPORTS
  bool
  default y if BR2_TOOLCHAIN_USES_GLIBC
	default y if BR2_TOOLCHAIN_USES_UCLIBC && \
		(BR2_arm || BR2_armeb || BR2_i386 || BR2_mips || BR2_mipsel || BR2_mips64 || BR2_mips64el || BR2_x86_64)

comment "zenfuse needs a uClibc or glibc toolchain w/ C++, threads, wchar, dynamic library"
	depends on !BR2_INSTALL_LIBSTDCPP || \
		!BR2_TOOLCHAIN_HAS_THREADS || !BR2_USE_WCHAR || \
		BR2_STATIC_LIBS || !BR2_PACKAGE_ZENFUSE_LIBC_SUPPORTS

config BR2_PACKAGE_ZENFUSE
  bool "zenfuse"
  depends on BR2_TOOLCHAIN_HAS_THREADS
  select BR2_PACKAGE_ZEROMQ
  select BR2_PACKAGE_ZMQPP
  select BR2_PACKAGE_ZMQPP_CLIENT
	select BR2_PACKAGE_LIBFUSE
  help
    Zen Fuse is a user-space file system front end for Zen Spaces
```

## br2_external/package/zenspaces/Config.in
```kconfig
config BR2_PACKAGE_ZENSPACES_LIBC_SUPPORTS
  bool
  default y if BR2_TOOLCHAIN_USES_GLIBC
	default y if BR2_TOOLCHAIN_USES_UCLIBC && \
		(BR2_arm || BR2_armeb || BR2_i386 || BR2_mips || BR2_mipsel || BR2_mips64 || BR2_mips64el || BR2_x86_64)

comment "zenspaces needs a uClibc or glibc toolchain w/ C++, threads, wchar, dynamic library"
	depends on !BR2_INSTALL_LIBSTDCPP || \
		!BR2_TOOLCHAIN_HAS_THREADS || !BR2_USE_WCHAR || \
		BR2_STATIC_LIBS || !BR2_PACKAGE_ZENSPACES_LIBC_SUPPORTS

config BR2_PACKAGE_ZENSPACES
  bool "zenspaces"
  depends on BR2_TOOLCHAIN_HAS_THREADS
  select BR2_PACKAGE_ZEROMQ
  select BR2_PACKAGE_LEVELDB
  select BR2_PACKAGE_ZMQPP
  select BR2_PACKAGE_ZMQPP_CLIENT
  select BR2_PACKAGE_SNAPPY
  help
    Zen Spaces is a replicated event sourced reactive object
    oriented database.
```
